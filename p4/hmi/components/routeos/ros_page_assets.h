// Generated by tools/embed_page.py - edit the files in web/ instead.
#pragma once

static const char PAGE_HTML[] = R"ROS_HTML(<!DOCTYPE html>
<html lang="en">
<head>
    <meta charset="UTF-8">
    <meta name="viewport" content="width=device-width, initial-scale=1, viewport-fit=cover">
    <title>Board setup — routeOS</title>
    <meta name="description" content="Join this routeOS board to a network and check that it can reach the internet.">
    <meta name="theme-color" content="#f5f2eb">
    <link rel="preconnect" href="https://fonts.googleapis.com">
    <link rel="preconnect" href="https://fonts.gstatic.com" crossorigin>
    <link href="https://fonts.googleapis.com/css2?family=Instrument+Serif:ital@0;1&family=Inter:wght@400;500;600&family=JetBrains+Mono:wght@400;500&display=swap" rel="stylesheet">
    <link rel="stylesheet" href="/paper.css">
    <link rel="stylesheet" href="/tool.css">
</head>
<body>
    <div id="paper-status" class="sr-only" role="status" aria-live="polite" aria-atomic="true"></div>
    <canvas class="scene" id="scene" aria-hidden="true"></canvas>

    <header class="nav" id="nav">
        <a class="nav__logo" href="/">routeOS <small id="boardTitle">board setup</small></a>
        <nav class="nav__links" id="navLinks" aria-label="Primary">
            <a href="#network">Network</a>
            <a href="#test">Test</a>
            <a href="#board">Board</a>
        </nav>
    </header>

    <main id="main">
        <section class="page-hero">
            <div class="wrap">
                <p class="eyebrow" data-enter>Setup</p>
                <h1 class="display" data-enter>Put this board <em>on the air</em></h1>
                <p class="lead" data-enter>Join a network, then prove the link reaches the internet. Nothing here
                    needs an app: it is the board answering for itself.</p>

                <div class="card" data-enter style="margin-top:26px;max-width:560px">
                    <div class="field">
                        <label class="label" for="token">Management token</label>
                        <input class="input" id="token" type="password" autocomplete="off" spellcheck="false"
                               placeholder="32 hex characters, printed on the serial console">
                        <p class="hint">Printed once at boot as <span class="mono">management token</span>. Kept in this
                            browser only, never sent anywhere but this board.</p>
                    </div>
                    <div class="btns" style="margin-top:16px">
                        <button class="btn btn--ink" id="unlockBtn" type="button">Unlock</button>
                        <span class="inline-status mono" id="unlockState">locked</span>
                    </div>
                </div>
            </div>
        </section>

        <section class="section" id="network" data-section>
            <div class="wrap">
                <div class="section-head section-head--split">
                    <div>
                        <p class="eyebrow" data-reveal>Network</p>
                        <h2 class="h2">Wi-Fi <em>connection</em></h2>
                    </div>
                    <p class="lead" data-reveal>A saved network wins over the one compiled into the firmware. If the new
                        one does not come up within twenty seconds, the board returns to the old one on its own.</p>
                </div>

                <div class="grid grid--2">
                    <article class="card" data-reveal>
                        <h3 class="h3">Status</h3>
                        <dl class="kv" id="wifiStatus">
                            <dt>Link</dt><dd id="stLink"><span class="badge badge--warn">unknown</span></dd>
                            <dt>Network</dt><dd id="stSsid">—</dd>
                            <dt>Address</dt><dd class="mono" id="stIp">—</dd>
                            <dt>Signal</dt><dd id="stRssi">—</dd>
                            <dt>Channel</dt><dd id="stChannel">—</dd>
                            <dt>MAC</dt><dd class="mono" id="stMac">—</dd>
                            <dt>Source</dt><dd id="stSource">—</dd>
                        </dl>
                        <div class="btns" style="margin-top:14px">
                            <button class="btn btn--sm" id="refreshBtn" type="button">Refresh</button>
                        </div>
                    </article>

                    <article class="card" data-reveal style="--d:60ms">
                        <h3 class="h3">Join a network</h3>
                        <div class="btns">
                            <button class="btn" id="scanBtn" type="button">Scan</button>
                            <span class="inline-status mono" id="scanState">idle</span>
                        </div>
                        <ul class="netlist" id="networks" aria-label="Networks found"></ul>

                        <div class="field" style="margin-top:16px">
                            <label class="label" for="ssid">Network name</label>
                            <input class="input" id="ssid" type="text" autocomplete="off" spellcheck="false"
                                   placeholder="pick one above or type it">
                        </div>
                        <div class="field">
                            <label class="label" for="password">Password</label>
                            <input class="input" id="password" type="password" autocomplete="current-password"
                                   placeholder="leave empty for an open network">
                        </div>
                        <div class="btns" style="margin-top:16px">
                            <button class="btn btn--ink" id="joinBtn" type="button">Join</button>
                        </div>
                        <p class="hint" id="joinHint">The board restarts its radio, so the page may stop answering for a
                            few seconds.</p>
                    </article>
                </div>
            </div>
        </section>

        <section class="section" id="test" data-section>
            <div class="wrap">
                <div class="section-head">
                    <p class="eyebrow" data-reveal>Link test</p>
                    <h2 class="h2">Reach <em>yeems214.xyz</em></h2>
                    <p class="lead" data-reveal>One HTTPS request from the board itself: DNS, TCP, TLS and the first byte,
                        timed. This is the honest question — the board can see the network without being able to use
                        it.</p>
                </div>

                <div class="btns" data-reveal>
                    <button class="btn btn--ink" id="testBtn" type="button">Test <span class="arrow">&rarr;</span></button>
                    <span class="inline-status mono" id="testState">not run</span>
                </div>
                <div class="banner" id="testResult" hidden role="status">
                    <p id="testText"></p>
                </div>
            </div>
        </section>

        <section class="section" id="board" data-section>
            <div class="wrap">
                <div class="section-head section-head--split">
                    <div>
                        <p class="eyebrow" data-reveal>Board</p>
                        <h2 class="h2">What this <em>is</em></h2>
                    </div>
                    <p class="lead" data-reveal>Read from the chip, not typed in.</p>
                </div>
                <dl class="kv grid grid--2" id="boardInfo">
                    <dt>Chip</dt><dd id="bdChip">—</dd>
                    <dt>Firmware</dt><dd id="bdFw">—</dd>
                    <dt>Flash</dt><dd id="bdFlash">—</dd>
                    <dt>PSRAM</dt><dd id="bdPsram">—</dd>
                    <dt>Free memory</dt><dd id="bdHeap">—</dd>
                    <dt>Uptime</dt><dd id="bdUptime">—</dd>
                </dl>
                <div class="btns" style="margin-top:18px">
                    <button class="btn btn--danger" id="rebootBtn" type="button">Restart board</button>
                </div>
            </div>
        </section>
    </main>

    <footer class="footer">
        <div class="wrap">
            <span>&copy; <span id="year">2026</span> routeOS</span>
            <nav aria-label="Footer"><a href="/api/capabilities">Capabilities JSON</a></nav>
        </div>
    </footer>

    <script src="/paper.js"></script>
    <script src="/setup.js"></script>
</body>
</html>
)ROS_HTML";
static const unsigned PAGE_HTML_LEN = 8456;

static const char PAGE_CSS[] = R"ROS_CSS(/* ============================================================
   PAPER — the house design system (sites + web tools)
   ============================================================
   Paper ground, ink type, ONE vermilion accent used sparingly.
   Instrument Serif display (italic carries the accent), Inter text,
   JetBrains Mono for small labels only. Mobile-first.

   Authoritative behaviour: GUIDELINES.md next to the skill.
   This file keeps the existing material (radii, type, vermilion)
   and applies the guide where it can: solid sheets instead of
   backdrop blur, 16px body, 44px targets, short interruptible
   motion, reduced motion, forced colors, and print.

   Load fonts:
   https://fonts.googleapis.com/css2?family=Instrument+Serif:ital@0;1&family=Inter:wght@400;500;600&family=JetBrains+Mono:wght@400;500&display=swap

   Layer order: paper.css (this) → tool.css (apps/dashboards) → the
   project's own page CSS. Never redefine the tokens per project;
   extend them.
   ============================================================ */

:root {
    --paper: #f5f2eb;
    --paper-hi: #faf8f3;
    --paper-lo: #ebe6db;
    --ink: #1c1b18;
    --ink-2: #4f4b43;
    /* #8a857a was 3.29:1 on paper. Same hue, darkened to clear 4.5:1 on paper-lo. */
    --ink-3: #6b675f;
    --line: rgba(28, 27, 24, 0.12);
    --line-2: rgba(28, 27, 24, 0.22);
    /* Essential control edges. Decorative rules stay on --line. ~3.7:1 on paper. */
    --line-strong: rgba(28, 27, 24, 0.55);
    --accent: #d2462f;
    /* Status hues darkened just enough for 4.5:1 text. Accent itself is unchanged. */
    --ok: #397352;
    --warn: #896010;
    --err: #b83d29;
    --down: #88837a;

    --serif: "Instrument Serif", "Iowan Old Style", Georgia, serif;
    --sans: "Inter", system-ui, -apple-system, "Segoe UI", sans-serif;
    --mono: "JetBrains Mono", ui-monospace, "SFMono-Regular", Menlo, monospace;

    --gutter: clamp(20px, 5vw, 56px);
    --maxw: 1200px;
    --nav-h: 64px;
    --radius: 18px;
    --radius-sm: 12px;

    --space-1: 4px;
    --space-2: 8px;
    --space-3: 12px;
    --space-4: 16px;
    --space-5: 24px;
    --space-6: 32px;
    --space-7: 48px;

    --ease-enter: cubic-bezier(.2, .8, .2, 1);
    --ease-state: cubic-bezier(.4, 0, .2, 1);
    --ease: var(--ease-enter);
    --dur-press: 120ms;
    --dur-state: 160ms;
    --dur-enter: 480ms;
    --dur-section: 560ms;
    --paper-shift: 8px;
    --paper-nudge: 3px;

    color-scheme: light;
}

*,
*::before,
*::after { box-sizing: border-box; }

html {
    -webkit-text-size-adjust: 100%;
    text-size-adjust: 100%;
    scroll-behavior: smooth;
    scroll-padding-top: calc(var(--nav-h) + var(--space-4));
}

[id] { scroll-margin-top: calc(var(--nav-h) + var(--space-4)); }

body {
    margin: 0;
    background: var(--paper);
    color: var(--ink);
    font-family: var(--sans);
    font-size: 16px;
    line-height: 1.5;
    -webkit-font-smoothing: antialiased;
    text-rendering: optimizeLegibility;
}

img { max-width: 100%; height: auto; display: block; }
a { color: inherit; }
button, input, select, textarea { font: inherit; color: inherit; }
strong { font-weight: 600; }
em { font-style: italic; }
code { font-family: var(--mono); font-size: .88em; background: var(--paper-lo); padding: .1em .35em; border-radius: 5px; }

::selection { background: var(--ink); color: var(--paper); }

:focus-visible {
    outline: 3px solid var(--accent);
    outline-offset: 3px;
    border-radius: 6px;
}

.sr-only {
    position: absolute !important;
    width: 1px; height: 1px;
    margin: -1px; padding: 0;
    overflow: hidden;
    clip: rect(0 0 0 0);
    white-space: nowrap;
    border: 0;
}

.skip {
    position: fixed;
    top: 12px; left: 12px;
    z-index: 100;
    padding: 10px 16px;
    min-height: 44px;
    background: var(--ink);
    color: var(--paper);
    border-radius: 999px;
    text-decoration: none;
    transform: translateY(-160%);
}
.skip:focus { transform: none; }

.mono { font-family: var(--mono); }
.reading, .stat__num { font-variant-numeric: tabular-nums; }

/* ---------- paper texture ----------
   Static fibre on the ground only. It does not sit on top of type,
   it does not take clicks, and it is not animated. */
body::after {
    content: "";
    position: fixed;
    inset: 0;
    z-index: 0;
    pointer-events: none;
    opacity: .22;
    background-image: url("data:image/svg+xml,%3Csvg xmlns='http://www.w3.org/2000/svg' width='220' height='220'%3E%3Cfilter id='n'%3E%3CfeTurbulence type='fractalNoise' baseFrequency='.85' numOctaves='3' stitchTiles='stitch'/%3E%3CfeColorMatrix values='0 0 0 0 .45 0 0 0 0 .42 0 0 0 0 .36 0 0 0 .09 0'/%3E%3C/filter%3E%3Crect width='100%25' height='100%25' filter='url(%23n)'/%3E%3C/svg%3E");
}
html[data-paper-effects="reduce"] body::after { display: none; }

/* ---------- 3D background layer ---------- */
.scene {
    position: fixed;
    inset: 0;
    z-index: 0;
    bottom: auto;
    width: 100%;
    height: 100vh;
    height: 100lvh;
    display: block;
    pointer-events: none;
    opacity: 0;
    transition: opacity var(--dur-enter) var(--ease-enter);
}
.scene.is-ready { opacity: 1; }
html[data-paper-effects="reduce"] .scene { opacity: 0 !important; visibility: hidden; }

main, .footer { position: relative; z-index: 1; }

/* ============================================================
   NAV
   ============================================================ */
.nav {
    position: fixed;
    inset: 0 0 auto 0;
    z-index: 50;
    height: var(--nav-h);
    display: flex;
    align-items: center;
    gap: var(--space-5);
    padding: 0 var(--gutter);
    background: transparent;
    border-bottom: 1px solid transparent;
    transition: background-color var(--dur-state) var(--ease-state), border-color var(--dur-state) var(--ease-state);
}
.nav.is-scrolled,
.nav.is-open {
    background: var(--paper);
    border-bottom-color: var(--line);
}

.nav__logo {
    display: inline-flex;
    align-items: baseline;
    gap: 10px;
    min-height: 44px;
    text-decoration: none;
    font-family: var(--serif);
    font-size: 24px;
    line-height: 1;
    letter-spacing: -.01em;
    white-space: nowrap;
}
.nav__logo small {
    font-family: var(--mono);
    font-size: 10.5px;
    letter-spacing: .14em;
    color: var(--ink-3);
    text-transform: uppercase;
}

.nav__links {
    margin-left: auto;
    display: flex;
    align-items: center;
    gap: var(--space-1);
}
.nav__links a {
    position: relative;
    display: inline-flex;
    align-items: center;
    min-height: 44px;
    padding: 8px 12px;
    border-radius: 999px;
    text-decoration: none;
    font-size: 14px;
    color: var(--ink-2);
    transition: color var(--dur-press) var(--ease-state), background-color var(--dur-press) var(--ease-state);
}
.nav__links a:hover { color: var(--ink); background: rgba(28, 27, 24, .05); }
.nav__links a[aria-current="page"] { color: var(--ink); }
.nav__links a[aria-current="page"]::after {
    content: "";
    position: absolute;
    left: 50%; bottom: 3px;
    width: 4px; height: 4px;
    margin-left: -2px;
    border-radius: 50%;
    background: var(--accent);
}
.nav__links .nav__cta {
    margin-left: 8px;
    color: var(--paper);
    background: var(--ink);
}
.nav__links .nav__cta:hover { background: #000; color: var(--paper); }

.nav__toggle {
    display: none;
    margin-left: auto;
    width: 44px; height: 44px;
    border: 1px solid var(--line-strong);
    border-radius: 50%;
    background: var(--paper);
    cursor: pointer;
    position: relative;
}
.nav__toggle span {
    position: absolute;
    left: 13px; right: 13px;
    height: 1.5px;
    background: var(--ink);
    transition: transform var(--dur-state) var(--ease-state), top var(--dur-state) var(--ease-state);
}
.nav__toggle span:first-child { top: 17px; }
.nav__toggle span:last-child { top: 25px; }
.nav.is-open .nav__toggle span:first-child { top: 21px; transform: rotate(45deg); }
.nav.is-open .nav__toggle span:last-child { top: 21px; transform: rotate(-45deg); }

@media (max-width: 900px) {
    .nav__toggle { display: block; }
    .nav__links {
        position: fixed;
        top: var(--nav-h);
        left: 0; right: 0;
        height: calc(100dvh - var(--nav-h));
        flex-direction: column;
        align-items: stretch;
        gap: 0;
        margin: 0;
        padding: 12px var(--gutter) calc(32px + env(safe-area-inset-bottom));
        background: var(--paper);
        overflow-y: auto;
        visibility: hidden;
        opacity: 0;
        transform: translateY(calc(var(--paper-shift) * -1));
        transition: opacity var(--dur-state) var(--ease-enter), transform var(--dur-state) var(--ease-enter), visibility 0s var(--dur-state);
    }
    .nav.is-open .nav__links {
        visibility: visible;
        opacity: 1;
        transform: none;
        transition: opacity var(--dur-state) var(--ease-enter), transform var(--dur-state) var(--ease-enter);
    }
    .nav__links a {
        padding: 14px 0;
        border-radius: 0;
        border-bottom: 1px solid var(--line);
        font-family: var(--serif);
        font-size: 34px;
        line-height: 1.1;
        color: var(--ink);
    }
    .nav__links a:hover { background: none; }
    .nav__links a[aria-current="page"]::after { left: auto; right: 4px; bottom: 50%; margin: 0 0 -3px; width: 7px; height: 7px; }
    .nav__links .nav__cta {
        margin: 28px 0 0;
        padding: 16px 24px;
        border-radius: 999px;
        border: 0;
        text-align: center;
        font-family: var(--sans);
        font-size: 16px;
    }
    body.nav-locked { overflow: hidden; }
}

/* ============================================================
   LAYOUT
   ============================================================ */
.wrap {
    width: 100%;
    max-width: calc(var(--maxw) + var(--gutter) * 2);
    margin: 0 auto;
    padding: 0 var(--gutter);
}

.section { padding: clamp(80px, 12vw, 168px) 0; }
.section--tight { padding: clamp(56px, 8vw, 104px) 0; }
.section + .section { padding-top: 0; }

.eyebrow {
    display: inline-flex;
    align-items: center;
    gap: 10px;
    margin: 0 0 20px;
    font-family: var(--mono);
    font-size: 11.5px;
    font-weight: 500;
    letter-spacing: .14em;
    text-transform: uppercase;
    color: var(--ink-3);
}
.eyebrow::before {
    content: "";
    width: 22px; height: 1px;
    background: currentColor;
}

.display {
    margin: 0;
    font-family: var(--serif);
    font-weight: 400;
    font-size: clamp(3.1rem, 11vw, 9.5rem);
    line-height: .92;
    letter-spacing: -.025em;
    overflow-wrap: break-word;
}
.display em, .h2 em, .h3 em { color: var(--accent); }

.h2 {
    margin: 0 0 24px;
    font-family: var(--serif);
    font-weight: 400;
    font-size: clamp(2.3rem, 5.6vw, 4.4rem);
    line-height: 1;
    letter-spacing: -.02em;
    overflow-wrap: break-word;
}
.h3 {
    margin: 0 0 10px;
    font-family: var(--serif);
    font-weight: 400;
    font-size: clamp(1.6rem, 3vw, 2.1rem);
    line-height: 1.08;
    letter-spacing: -.01em;
}

.lead {
    max-width: 62ch;
    margin: 0 0 20px;
    font-size: clamp(1.05rem, 1.6vw, 1.22rem);
    line-height: 1.5;
    color: var(--ink-2);
}
.lead:last-child { margin-bottom: 0; }
.muted { color: var(--ink-3); }

.section-head {
    display: grid;
    gap: var(--space-3);
    margin-bottom: clamp(36px, 6vw, 64px);
}
@media (min-width: 900px) {
    .section-head--split {
        grid-template-columns: 1fr 1fr;
        align-items: end;
        gap: var(--space-7);
    }
    .section-head--split .lead { margin: 0; }
}

/* ---------- buttons & links ---------- */
.btn {
    display: inline-flex;
    align-items: center;
    justify-content: center;
    gap: 10px;
    min-height: 48px;
    min-width: 44px;
    padding: 12px 24px;
    border: 1px solid var(--ink);
    border-radius: 999px;
    background: transparent;
    color: var(--ink);
    font-size: 15px;
    font-weight: 500;
    text-decoration: none;
    cursor: pointer;
    transition: background-color var(--dur-press) var(--ease-state), color var(--dur-press) var(--ease-state), border-color var(--dur-press) var(--ease-state), opacity var(--dur-press) var(--ease-state);
}
.btn:hover { background: var(--ink); color: var(--paper); }
.btn:active { opacity: 0.84; }
.btn--ink { background: var(--ink); color: var(--paper); }
.btn--ink:hover, .btn--ink:active { background: #000; }
.btn--lg { min-height: 58px; padding: 16px 32px; font-size: 16px; }
.btn .arrow { display: inline-block; transition: transform var(--dur-press) var(--ease-state); }
.btn:hover .arrow { transform: translateX(var(--paper-nudge)); }

.btns { display: flex; flex-wrap: wrap; gap: var(--space-3); }

.link {
    display: inline-flex;
    align-items: center;
    gap: 8px;
    min-height: 44px;
    margin-top: 32px;
    font-size: 15px;
    font-weight: 500;
    text-decoration: none;
    border-bottom: 1px solid var(--line-strong);
    padding-bottom: 3px;
    transition: border-color var(--dur-press) var(--ease-state);
}
.link:hover { border-color: var(--ink); }
.lead .link, p .link { margin-top: 0; min-height: 0; }

/* ---------- surfaces ----------
   Opaque paper sheets. Blur is not part of the material. */
.card {
    position: relative;
    padding: clamp(22px, 3vw, 32px);
    background: var(--paper-hi);
    border: 1px solid var(--line);
    border-radius: var(--radius);
    transition: border-color var(--dur-state) var(--ease-state);
}
.card:hover { border-color: var(--line-strong); }
.card:not(a):not(button) { cursor: auto; }

.chips { display: flex; flex-wrap: wrap; gap: 6px; }
.chip {
    display: inline-block;
    padding: 5px 11px;
    border: 1px solid var(--line-2);
    border-radius: 999px;
    font-family: var(--mono);
    font-size: 11px;
    letter-spacing: .04em;
    color: var(--ink-2);
    background: var(--paper-hi);
}

.dot {
    display: inline-block;
    width: 7px; height: 7px;
    border-radius: 50%;
    background: var(--ok);
    vertical-align: middle;
    box-shadow: inset 0 0 0 1px rgba(28, 27, 24, .35);
}
.dot--ok, .dot--live { background: var(--ok); }
.dot--warn { background: var(--warn); }
.dot--err { background: var(--err); }
.dot--down { background: var(--down); }

.frame {
    margin: 0;
    overflow: hidden;
    border-radius: var(--radius);
    background: var(--paper-lo);
    border: 1px solid var(--line);
}
.frame img {
    width: 100%;
    height: 100%;
    object-fit: cover;
    filter: saturate(.92) contrast(1.02);
}
.frame figcaption {
    padding: 12px 16px;
    font-family: var(--mono);
    font-size: 11px;
    letter-spacing: .06em;
    color: var(--ink-3);
    background: var(--paper-hi);
    border-top: 1px solid var(--line);
}

.rule { height: 1px; background: var(--line); border: 0; margin: 0; }

/* Mandatory motion. paper.js adds .is-in. Without JS there is no .js
   class, so nothing stays hidden. --paper-shift is 0 under reduced
   motion, which leaves a fade and drops the travel. */
.js [data-enter]:not(.is-in),
.js [data-reveal]:not(.is-in),
.js [data-section]:not(.is-in),
.js .is-motion:not(.is-in) { opacity: 0; }
.js [data-enter].is-in,
.js [data-reveal].is-in,
.js [data-section].is-in,
.js .is-motion.is-in {
    opacity: 1;
    animation: paper-in var(--dur-enter) var(--ease-enter) both;
    animation-delay: var(--d, 0ms);
}
.js [data-section].is-in { animation-duration: var(--dur-section); }
@keyframes paper-in {
    from { opacity: 0; transform: translateY(var(--paper-shift)); }
    to { opacity: 1; transform: none; }
}
[data-state] {
    transition: background-color var(--dur-state) var(--ease-state), color var(--dur-state) var(--ease-state), border-color var(--dur-state) var(--ease-state), opacity var(--dur-press) var(--ease-state);
}
.btn[data-state="on"] { background: var(--ink); color: var(--paper); }

/* ============================================================
   HERO (landing) + PAGE HERO (inner pages)
   The title is readable immediately. It does not wait on fonts,
   observers, or a curtain animation.
   ============================================================ */
.hero {
    position: relative;
    min-height: 100svh;
    display: flex;
    flex-direction: column;
    justify-content: flex-end;
    padding: calc(var(--nav-h) + 40px) 0 clamp(40px, 7vh, 80px);
}
.hero__inner { display: grid; gap: 28px; }
.hero__title { max-width: 11ch; }
.hero__title .line { display: block; }
.hero__title .line > span { display: inline-block; }

.hero__foot {
    display: grid;
    gap: 28px;
    align-items: end;
}
.hero__sub { max-width: 38ch; margin: 0; font-size: clamp(1.05rem, 1.8vw, 1.25rem); color: var(--ink-2); }
.hero__sub em { font-family: var(--serif); font-size: 1.2em; color: var(--ink); }
.hero__meta {
    display: flex;
    flex-wrap: wrap;
    gap: 8px 20px;
    font-family: var(--mono);
    font-size: 11.5px;
    letter-spacing: .1em;
    text-transform: uppercase;
    color: var(--ink-3);
}

@media (min-width: 900px) {
    .hero__foot { grid-template-columns: 1.1fr 1fr; gap: 48px; }
    .hero__foot .btns { justify-content: flex-end; }
}

.page-hero {
    position: relative;
    padding: calc(var(--nav-h) + clamp(64px, 12vw, 150px)) 0 clamp(56px, 8vw, 110px);
}
.page-hero .display { font-size: clamp(3rem, 9vw, 7.6rem); max-width: 12ch; }
.page-hero .lead { margin-top: 28px; }
/* On a phone the 3D layer can only be seen where there is no text, so
   heroes that own a scene leave it a clear stage beneath the copy. */
@media (max-width: 760px) {
    .page-hero--stage { padding-bottom: 38vh; }
}
/* On a phone the sign-in form would cover the still life, so the stage
   is a clear band between the sentence and the card. */
.login-stage { height: 0; }
@media (max-width: 899px) {
    .login-stage { height: 15vh; }
    .page-hero--stage:has(.login-stage) { padding-bottom: clamp(48px, 10vw, 96px); }
}
.scene-fallback {
    position: absolute;
    z-index: 1;
    left: var(--gutter);
    right: var(--gutter);
    bottom: 16px;
    max-width: 40ch;
    margin: 0;
}
.login-grid { display: grid; gap: clamp(28px, 5vw, 64px); align-items: center; }
.login-card { width: min(100%, 440px); }
@media (min-width: 900px) {
    .login-grid { grid-template-columns: 1.15fr .85fr; }
    .login-card { justify-self: end; }
}

.page-hero--split .wrap { display: grid; gap: 48px; align-items: end; }
.page-hero--split .frame { max-width: 440px; aspect-ratio: 4 / 5; }
.page-hero--split .frame img { aspect-ratio: 4 / 5; height: auto; }
@media (min-width: 960px) {
    .page-hero--split .wrap { grid-template-columns: 1.5fr 1fr; gap: 72px; }
    .page-hero--split .frame { justify-self: end; width: 100%; }
}

/* ============================================================
   STATS
   ============================================================ */
.stats {
    display: grid;
    grid-template-columns: repeat(2, 1fr);
    border-top: 1px solid var(--line);
    border-left: 1px solid var(--line);
}
.stat {
    padding: clamp(20px, 3vw, 32px);
    border-right: 1px solid var(--line);
    border-bottom: 1px solid var(--line);
    background: var(--paper-hi);
}
.stat__num {
    display: block;
    font-family: var(--serif);
    font-size: clamp(2.4rem, 5vw, 3.6rem);
    line-height: 1;
    letter-spacing: -.02em;
}
.stat__num--accent { color: var(--accent); }
.stat__label {
    display: block;
    margin-top: 10px;
    font-family: var(--mono);
    font-size: 11px;
    letter-spacing: .1em;
    text-transform: uppercase;
    color: var(--ink-3);
}
@media (min-width: 700px) { .stats { grid-template-columns: repeat(3, 1fr); } }
@media (min-width: 1100px) { .stats--6 { grid-template-columns: repeat(6, 1fr); } .stats--4 { grid-template-columns: repeat(4, 1fr); } }


/* ============================================================
   GRID
   ============================================================ */
.grid { display: grid; gap: var(--space-4); }
@media (min-width: 700px) { .grid--2 { grid-template-columns: repeat(2, 1fr); } }
@media (min-width: 1040px) { .grid--3 { grid-template-columns: repeat(3, 1fr); } }
@media (min-width: 700px) and (max-width: 1039px) { .grid--3 { grid-template-columns: repeat(2, 1fr); } }

/* ============================================================
   PAGE CTA + FOOTER
   ============================================================ */
.cta { text-align: center; }
.cta .h2 { font-size: clamp(2.6rem, 7vw, 5.6rem); }
.cta .btns { justify-content: center; margin-top: 32px; }
.cta .link { margin-top: 24px; }

.footer {
    border-top: 1px solid var(--line);
    background: var(--paper);
}
.footer .wrap {
    display: flex;
    flex-wrap: wrap;
    justify-content: space-between;
    align-items: center;
    gap: 16px 32px;
    padding-top: 32px;
    padding-bottom: calc(32px + env(safe-area-inset-bottom));
    font-family: var(--mono);
    font-size: 11.5px;
    letter-spacing: .06em;
    color: var(--ink-3);
}
.footer a {
    display: inline-flex;
    align-items: center;
    min-height: 44px;
    color: var(--ink-2);
    text-decoration: none;
    border-bottom: 1px solid var(--line-strong);
}
.footer a:hover { color: var(--ink); border-color: var(--ink); }
.footer nav { display: flex; flex-wrap: wrap; gap: 8px 22px; }

@media (pointer: coarse) {
    .btn, .nav__toggle, .nav__links a, .footer a, .nav__logo, .link {
        min-height: 48px;
    }
    p .link, .lead .link { min-height: 0; }
}

/* Reduced motion keeps fades and color/opacity feedback.
   It removes travel, nudge, and scroll smoothing. It does not
   set animation: none. The in-app flag can only strengthen the OS. */
@media (prefers-reduced-motion: reduce) {
    html { scroll-behavior: auto; }
    :root { --paper-shift: 0px; --paper-nudge: 0px; }
}
html[data-paper-motion="reduce"] {
    scroll-behavior: auto;
    --paper-shift: 0px;
    --paper-nudge: 0px;
}

@media (forced-colors: active) {
    body::after, .scene { display: none !important; }
    .card, .stat, .nav.is-scrolled, .nav.is-open, .footer, .frame {
        background: Canvas;
        box-shadow: none;
    }
    :focus-visible { outline: 3px solid Highlight; outline-offset: 3px; }
    .btn, .nav__toggle, .chip { border-color: ButtonText; }
    .dot { background: CanvasText; }
}

@media print {
    .is-motion, [data-enter], [data-reveal], [data-section] {
        opacity: 1 !important;
        animation: none !important;
        transform: none !important;
    }
    body { background: #fff; color: #000; }
    body::after, .scene, .nav, .skip, .nav__toggle { display: none !important; }
    .card, .stat, .frame, .footer { background: #fff; box-shadow: none; }
    main, .footer { position: static; }
    a { text-decoration: underline; }
}
)ROS_CSS";
static const unsigned PAGE_CSS_LEN = 22732;

static const char PAGE_TOOL_CSS[] = R"ROS_TOOL(/* ============================================================
   PAPER / TOOL — components for web apps, dashboards, admin UIs
   Load after paper.css. Uses only paper.css tokens.
   Density is higher than on a marketing page, but the grammar is
   the same: solid paper sheets, hairlines, ink text, mono for
   labels, serif for the one number or title that matters.
   No backdrop blur. Standalone controls are at least 44px.
   ============================================================ */

/* ---------- app shell: sidebar + content ----------
   Narrow screens keep the sidebar in document order as navigation,
   instead of removing it. A sidebar that cannot fit is not hidden. */
.app {
    display: grid;
    min-height: 100dvh;
    grid-template-columns: minmax(0, 1fr);
}
.app__side {
    display: block;
    position: relative;
    height: auto;
    padding: 22px 16px;
    border-bottom: 1px solid var(--line);
    background: var(--paper-hi);
    overflow-y: auto;
}
.app__brand { display: flex; align-items: center; min-height: 44px; margin: 0 8px 16px; font-family: var(--serif); font-size: 24px; line-height: 1; text-decoration: none; }
.app__nav { display: grid; gap: 2px; }
.app__nav a {
    display: flex; align-items: center; gap: 10px;
    min-height: 44px;
    padding: 9px 12px;
    border-radius: 10px;
    font-size: 14px;
    color: var(--ink-2);
    text-decoration: none;
}
.app__nav a:hover { background: rgba(28, 27, 24, .05); color: var(--ink); }
.app__nav a[aria-current="page"] { background: var(--ink); color: var(--paper); }
.app__navlabel { margin: 18px 12px 6px; font-family: var(--mono); font-size: 11px; letter-spacing: .14em; text-transform: uppercase; color: var(--ink-3); }
.app__main { min-width: 0; padding: 20px var(--gutter) 48px; }
.app__top { display: flex; flex-wrap: wrap; align-items: end; justify-content: space-between; gap: 12px 24px; margin-bottom: 20px; }
.app__title { margin: 0; font-family: var(--serif); font-weight: 400; font-size: clamp(1.9rem, 3.6vw, 2.8rem); line-height: 1.05; overflow-wrap: anywhere; }
@media (min-width: 1000px) {
    .app { grid-template-columns: 240px minmax(0, 1fr); }
    .app__side {
        position: sticky;
        top: 0;
        height: 100dvh;
        border-bottom: 0;
        border-right: 1px solid var(--line);
    }
    .app__main { padding-top: 32px; }
}
@media (pointer: coarse) {
    .app__nav a, .app__brand { min-height: 48px; }
}

/* List + inspector. One column until the inspector fits beside the list. */
.workspace {
    display: grid;
    grid-template-columns: minmax(0, 1fr);
    gap: var(--space-5);
}
.inspector { min-inline-size: 0; }
@media (min-width: 60rem) {
    .workspace { grid-template-columns: minmax(0, 1fr) minmax(18rem, 24rem); gap: var(--space-5); }
}

/* ---------- panes ---------- */
.pane {
    min-width: 0;
    padding: 18px;
    background: var(--paper-hi);
    border: 1px solid var(--line);
    border-radius: var(--radius);
}
.pane__head { display: flex; flex-wrap: wrap; align-items: center; justify-content: space-between; gap: 10px; margin-bottom: 14px; }
.pane__title { margin: 0; font-family: var(--mono); font-size: 11px; font-weight: 500; letter-spacing: .12em; text-transform: uppercase; color: var(--ink-3); }

.metric {
    display: grid;
    gap: var(--space-1);
    align-content: start;
}
.metric__label { font-family: var(--mono); font-size: 11px; letter-spacing: .12em; text-transform: uppercase; color: var(--ink-3); }
.metric__value { font-family: var(--serif); font-size: clamp(1.8rem, 3vw, 2.4rem); line-height: 1; font-variant-numeric: tabular-nums; }
.metric__unit { font-family: var(--sans); font-size: 1rem; font-weight: 500; color: var(--ink); }
.metric__meta { font-size: 13px; color: var(--ink-2); }
.metric.is-missing .metric__value { color: var(--ink-2); }

/* KPI tile: a mono label and one serif number. */
.kpi { display: grid; gap: 4px; }
.kpi__label { font-family: var(--mono); font-size: 11px; letter-spacing: .12em; text-transform: uppercase; color: var(--ink-3); }
.kpi__val { font-family: var(--serif); font-size: clamp(1.8rem, 3vw, 2.4rem); line-height: 1; font-variant-numeric: tabular-nums; }
.kpi__delta { font-family: var(--mono); font-size: 12px; color: var(--ink-2); }
.kpi__delta.is-up { color: var(--ok); }
.kpi__delta.is-down { color: var(--err); }

/* ---------- toolbar + small buttons ----------
   --sm is typographic density. The hit area stays ≥44px. */
.toolbar { display: flex; flex-wrap: wrap; align-items: center; gap: 8px; }
.btn--sm {
    min-height: 44px;
    min-width: 44px;
    padding: 8px 14px;
    font-family: var(--mono);
    font-size: 12px;
    font-weight: 500;
    letter-spacing: .04em;
    border-color: var(--line-strong);
}
.btn--sm:hover { border-color: var(--ink); background: transparent; color: var(--ink); }
.btn--sm.btn--ink:hover { background: #000; color: var(--paper); }
.btn[aria-pressed="true"] { background: var(--ink); color: var(--paper); border-color: var(--ink); }
.btn--danger { border-color: var(--err); color: var(--err); }
.btn--danger:hover, .btn--danger:active { background: var(--err); color: var(--paper); border-color: var(--err); }
.btn:disabled, .btn[aria-disabled="true"] { opacity: 1; color: var(--ink-3); background: var(--paper-lo); border-color: var(--line-strong); cursor: not-allowed; }
.disabled-reason { flex-basis: 100%; margin: 0; font-size: 13px; color: var(--ink-2); }

.inline-status {
    display: inline-flex;
    align-items: center;
    min-height: 44px;
    font-family: var(--mono);
    font-size: 12px;
    letter-spacing: .02em;
    color: var(--ink-2);
}

/* Segmented control. */
.seg { display: inline-flex; flex-wrap: wrap; padding: 3px; border: 1px solid var(--line-strong); border-radius: 999px; background: var(--paper-hi); }
.seg button {
    min-height: 44px; min-width: 44px; padding: 8px 14px;
    border: 0; border-radius: 999px; background: transparent;
    font-family: var(--mono); font-size: 12px; letter-spacing: .04em; color: var(--ink-2);
    cursor: pointer;
}
.seg button[aria-pressed="true"], .seg button[aria-selected="true"] { background: var(--ink); color: var(--paper); }

/* Tabs. Arrow keys are handled in paper.js when role=tablist is set. */
.tabs { display: flex; gap: 22px; border-bottom: 1px solid var(--line); margin-bottom: 18px; overflow-x: auto; scrollbar-width: none; }
.tabs::-webkit-scrollbar { display: none; }
.tabs [role="tab"] {
    flex: 0 0 auto;
    min-height: 44px;
    padding: 10px 0 12px;
    border: 0; background: none;
    border-bottom: 2px solid transparent;
    margin-bottom: -1px;
    font-size: 14px; color: var(--ink-2);
    cursor: pointer;
}
.tabs [role="tab"][aria-selected="true"] { color: var(--ink); border-bottom-color: var(--accent); }

/* ---------- forms ---------- */
.field { display: grid; gap: 6px; }
.field + .field { margin-top: 14px; }
.label { font-family: var(--mono); font-size: 11px; letter-spacing: .12em; text-transform: uppercase; color: var(--ink-3); }
.hint { margin: 0; font-size: 13px; color: var(--ink-2); }
.error { margin: 0; font-size: 13px; color: var(--err); }
.error-summary {
    margin: 0 0 16px;
    padding: 12px 16px;
    border: 1px solid var(--err);
    border-radius: var(--radius-sm);
    background: var(--paper-hi);
    color: var(--ink);
}
.error-summary a { color: var(--err); }

.input, .select, .textarea {
    width: 100%;
    min-height: 46px;
    padding: 11px 14px;
    border: 1px solid var(--line-strong);
    border-radius: var(--radius-sm);
    background: var(--paper-hi);
    color: var(--ink);
    font: inherit;
    font-size: 16px;            /* ≥16px: stops iOS zooming on focus */
    transition: border-color var(--dur-press) var(--ease-state);
}
.textarea { min-height: 110px; resize: vertical; line-height: 1.5; }
.input::placeholder, .textarea::placeholder { color: var(--ink-3); }
.input:focus, .select:focus, .textarea:focus { border-color: var(--ink); }
.input[aria-invalid="true"], .select[aria-invalid="true"], .textarea[aria-invalid="true"] { border-color: var(--err); }
.select {
    appearance: none;
    padding-right: 38px;
    background-image: linear-gradient(45deg, transparent 50%, var(--ink-2) 50%), linear-gradient(135deg, var(--ink-2) 50%, transparent 50%);
    background-position: calc(100% - 20px) 50%, calc(100% - 15px) 50%;
    background-size: 5px 5px;
    background-repeat: no-repeat;
}
.check { display: inline-flex; align-items: center; gap: 10px; min-height: 44px; font-size: 15px; cursor: pointer; }
.check input { width: 18px; height: 18px; accent-color: var(--ink); }

fieldset.sheet {
    margin: 0 0 16px;
    padding: 16px;
    border: 1px solid var(--line);
    border-radius: var(--radius-sm);
    min-inline-size: 0;
}
fieldset.sheet legend {
    padding: 0 8px;
    font-family: var(--mono);
    font-size: 11px;
    letter-spacing: .12em;
    text-transform: uppercase;
    color: var(--ink-3);
}

details.disclosure { border-top: 1px solid var(--line); padding: 4px 0 8px; }
details.disclosure summary {
    display: flex;
    align-items: center;
    min-height: 44px;
    cursor: pointer;
    font-weight: 500;
}
details.disclosure summary:focus-visible { outline-offset: 4px; }

/* Quiet ink progress. The label carries the fraction; the bar does not animate past the value. */
progress {
    display: block;
    width: min(100%, 280px);
    height: 4px;
    border: 0;
    border-radius: 999px;
    background: var(--paper-lo);
    color: var(--ink);
    appearance: none;
}
progress::-webkit-progress-bar { background: var(--paper-lo); border-radius: 999px; }
progress::-webkit-progress-value { background: var(--ink); border-radius: 999px; }
progress::-moz-progress-bar { background: var(--ink); }

/* ---------- tables ---------- */
.table-wrap { overflow-x: auto; border: 1px solid var(--line-strong); border-radius: 14px; background: var(--paper-hi); }
.table-wrap:focus-visible { outline: 3px solid var(--accent); outline-offset: 2px; }
.table { width: 100%; border-collapse: collapse; font-size: 14px; }
.table caption {
    caption-side: top;
    padding: 12px 14px 0;
    text-align: left;
    font-family: var(--mono);
    font-size: 11px;
    letter-spacing: .12em;
    text-transform: uppercase;
    color: var(--ink-3);
}
.table th {
    position: sticky; top: 0;
    padding: 0 14px;
    text-align: left;
    font-family: var(--mono); font-size: 11px; font-weight: 500; letter-spacing: .08em; text-transform: uppercase;
    color: var(--ink-3);
    background: var(--paper-hi);
    border-bottom: 1px solid var(--line);
    white-space: nowrap;
}
.table th button {
    display: inline-flex;
    align-items: center;
    min-height: 44px;
    margin: 0;
    padding: 8px 0;
    border: 0;
    background: transparent;
    color: inherit;
    font: inherit;
    letter-spacing: inherit;
    text-transform: inherit;
    cursor: pointer;
}
.table td { padding: 12px 14px; border-bottom: 1px solid var(--line); vertical-align: middle; }
.table tr:last-child td { border-bottom: 0; }
.table tbody tr:hover { background: rgba(28, 27, 24, .025); }
.table tbody tr[aria-selected="true"] { outline: 2px solid var(--ink); outline-offset: -2px; }
.table .num { text-align: right; font-variant-numeric: tabular-nums; }
/* Below 640px, rows become cards: give each td a data-label.
   The thead stays available to assistive tech; it is visually hidden. */
@media (max-width: 640px) {
    .table--stack thead {
        position: absolute;
        width: 1px; height: 1px;
        overflow: hidden;
        clip: rect(0 0 0 0);
    }
    .table--stack, .table--stack tbody, .table--stack tr, .table--stack td { display: block; width: 100%; }
    .table--stack tr { padding: 10px 14px; border-bottom: 1px solid var(--line); }
    .table--stack td { display: flex; justify-content: space-between; gap: 16px; padding: 8px 0; border: 0; min-height: 44px; align-items: center; min-width: 0; overflow-wrap: anywhere; }
    .table--stack td::before { content: attr(data-label); font-family: var(--mono); font-size: 11px; letter-spacing: .08em; text-transform: uppercase; color: var(--ink-3); }
}

/* ---------- key/value, badges, status ---------- */
.kv { display: grid; grid-template-columns: max-content minmax(0, 1fr); gap: 8px 16px; margin: 0; font-size: 14px; }
.kv dt { font-family: var(--mono); font-size: 11px; letter-spacing: .1em; text-transform: uppercase; color: var(--ink-3); padding-top: 3px; }
.kv dd { margin: 0; color: var(--ink-2); overflow-wrap: anywhere; }

.badge {
    display: inline-flex; align-items: center; gap: 6px;
    min-height: 28px;
    padding: 4px 9px;
    border: 1px solid var(--line-strong);
    border-radius: 999px;
    font-family: var(--mono); font-size: 12px; letter-spacing: .04em;
    color: var(--ink);
    background: var(--paper-hi);
    white-space: nowrap;
}
.badge--ok { border-color: var(--ok); color: var(--ok); }
.badge--warn { border-color: var(--warn); color: var(--warn); }
.badge--err { border-color: var(--err); color: var(--err); }
.badge--ink { background: var(--ink); color: var(--paper); border-color: var(--ink); }

.status-critical {
    font-weight: 600;
    border-inline-start: 4px solid var(--err);
    padding-inline-start: 8px;
}

.banner {
    display: flex; gap: 12px; align-items: flex-start;
    padding: 12px 16px;
    border-radius: var(--radius-sm);
    border: 1px solid var(--line-strong);
    background: var(--paper-hi);
    font-size: 14px;
    color: var(--ink);
}
.banner--warn { border-color: var(--warn); }
.banner--err { border-color: var(--err); }
.banner--ok { border-color: var(--ok); }
.banner p { margin: 0; }

.margin-note {
    margin: 8px 0 0;
    padding-inline-start: 12px;
    border-inline-start: 2px solid var(--line-strong);
    font-size: 13px;
    color: var(--ink-2);
}

.receipt {
    padding: 16px;
    border: 1px solid var(--line-strong);
    border-radius: var(--radius-sm);
    background: var(--paper);
}
.receipt h2, .receipt h3 { margin: 0 0 8px; font-family: var(--serif); font-weight: 400; }
.receipt ul { margin: 8px 0 0; padding-left: 1.2em; }

.action-rule {
    display: flex;
    flex-wrap: wrap;
    align-items: center;
    gap: 8px;
    margin-top: var(--space-5);
    padding-top: var(--space-4);
    border-top: 1px solid var(--ink);
}

.empty { padding: 48px 20px; text-align: center; color: var(--ink-2); }
.empty strong { display: block; margin-bottom: 6px; font-family: var(--serif); font-weight: 400; font-size: 1.6rem; color: var(--ink); }
.empty p { margin: 0; }

.log {
    max-height: 280px; overflow-y: auto;
    padding: 10px 12px;
    border: 1px solid var(--line-strong); border-radius: var(--radius-sm);
    background: var(--paper-hi);
    font-family: var(--mono); font-size: 12px; line-height: 1.6;
    color: var(--ink);
    overscroll-behavior: contain;
}

/* ---------- dialog (native <dialog>) ---------- */
dialog.dialog {
    animation: paper-in var(--dur-state) var(--ease-enter);
    width: min(560px, calc(100vw - 32px));
    max-height: calc(100dvh - 48px);
    padding: 0;
    border: 1px solid var(--line-strong);
    border-radius: calc(var(--radius) + 2px);
    background: var(--paper-hi);
    color: var(--ink);
    box-shadow: 0 24px 48px -28px rgba(28, 27, 24, .45);
}
dialog.dialog::backdrop { background: rgba(28, 27, 24, .46); }
.dialog__head { padding: 20px 22px 0; }
.dialog__title { margin: 0; font-family: var(--serif); font-weight: 400; font-size: 1.9rem; line-height: 1.1; }
.dialog__body { padding: 16px 22px; overflow-y: auto; }
.dialog__foot { display: flex; flex-wrap: wrap; justify-content: flex-end; gap: 8px; padding: 14px 22px 20px; border-top: 1px solid var(--line); }
@media (max-width: 600px) {
    dialog.dialog {
        margin: auto 0 0;
        width: 100vw;
        max-width: 100vw;
        max-height: 85dvh;
        border-radius: var(--radius) var(--radius) 0 0;
    }
}

/* ---------- toast ----------
   A toast is a spare notice. Consequential outcomes also need a
   persistent .receipt on the page. */
.toasts { position: fixed; right: 16px; bottom: calc(16px + env(safe-area-inset-bottom)); z-index: 90; display: grid; gap: 8px; width: min(360px, calc(100vw - 32px)); }
.toast {
    padding: 12px 16px;
    border-radius: var(--radius-sm);
    background: var(--ink);
    color: var(--paper);
    font-size: 14px;
    box-shadow: 0 16px 32px -20px rgba(28, 27, 24, .6);
}
@media (max-width: 600px) { .toasts { left: 16px; width: auto; } }

/* ---------- skeleton ---------- */
.skeleton {
    border-radius: 8px;
    background: var(--paper-lo);
    animation: skel 1.4s ease-in-out infinite;
}
@keyframes skel {
    from { background-color: var(--paper-lo); }
    50% { background-color: var(--paper-hi); }
    to { background-color: var(--paper-lo); }
}

@media (pointer: coarse) {
    .btn--sm, .seg button, .tabs [role="tab"], .check, details.disclosure summary, .table th button { min-height: 48px; }
}

@media (forced-colors: active) {
    .pane, .banner, .badge, .receipt, dialog.dialog, .table-wrap, .input, .select, .textarea {
        background: Canvas;
        color: CanvasText;
        border: 1px solid CanvasText;
        box-shadow: none;
    }
    dialog.dialog::backdrop { background: Canvas; }
    .btn--ink, .app__nav a[aria-current="page"], .badge--ink { background: ButtonText; color: ButtonFace; forced-color-adjust: none; }
    :focus-visible { outline-color: Highlight; }
}

@media print {
    .app__side, .toasts, .toolbar, .nav__toggle { display: none !important; }
    .app { display: block; }
    .pane, .receipt, .banner, dialog.dialog { box-shadow: none; background: #fff; }
    .table-wrap { overflow: visible; }
}
)ROS_TOOL";
static const unsigned PAGE_TOOL_CSS_LEN = 17688;

static const char PAGE_JS[] = R"ROS_PAPERJS(/* ============================================================
   PAPER — shared page behaviour
   No dependencies. Without this script the pages stay readable.
   The 3D layer lives in scenes-kit.js and does not depend on this file.

   Motion, stagger, phase labels, and numeric sort keys mirror
   kit/paper-policy.mjs. Keep the marked functions in sync.
   ============================================================ */
(function () {
    'use strict';

    var root = document.documentElement;
    root.classList.add('js');

    function closest(target, selector) {
        var node = target && target.nodeType === 1 ? target : target && target.parentElement;
        return node && node.closest ? node.closest(selector) : null;
    }

    var reduced = window.matchMedia('(prefers-reduced-motion: reduce)');
    var MOTION_KEY = 'paper-reduce-motion';
    var EFFECTS_KEY = 'paper-reduce-effects';

    /* mirrored in paper-policy.mjs */
    var PHASE_LABEL = {
        idle: '',
        submitting: 'Requesting',
        accepted: 'Request accepted; verification pending',
        verified: 'Verified',
        failed: 'Failed',
        unknown: 'Unknown outcome. Reconcile this request before retrying.'
    };

    function motionReduced() {
        return reduced.matches || root.getAttribute('data-paper-motion') === 'reduce';
    }
    function effectsReduced() {
        return root.getAttribute('data-paper-effects') === 'reduce';
    }

    function readStore(key) {
        try { return window.localStorage.getItem(key); } catch (err) { return null; }
    }
    function writeStore(key, value) {
        try { window.localStorage.setItem(key, value); } catch (err) { /* private mode */ }
    }

    /* mirrored in paper-policy.mjs */
    function parseStrictNumber(raw) {
        var text = String(raw == null ? '' : raw).trim();
        if (!/^[+-]?(?:\d+(?:\.\d+)?|\.\d+)$/.test(text)) return null;
        var value = Number(text);
        if (!Number.isFinite(value)) return null;
        return Object.is(value, -0) ? 0 : value;
    }

    /* mirrored in paper-policy.mjs */
    function compareCell(a, b, type, direction) {
        var dir = direction === 'descending' ? -1 : 1;
        if (type === 'number') {
            var na = parseStrictNumber(a);
            var nb = parseStrictNumber(b);
            if (na === null && nb === null) return 0;
            if (na === null) return 1;
            if (nb === null) return -1;
            return (na - nb) * dir;
        }
        return String(a).localeCompare(String(b), undefined, { numeric: true, sensitivity: 'base' }) * dir;
    }

    function phaseLabel(phase) {
        return Object.prototype.hasOwnProperty.call(PHASE_LABEL, phase) ? PHASE_LABEL[phase] : '';
    }

    var lastAnnounce = { key: '', at: 0 };
    function announce(message, id) {
        if (!message) return;
        var now = Date.now();
        var key = String(id || '') + '|' + message;
        if (key === lastAnnounce.key && now - lastAnnounce.at < 1000) return;
        lastAnnounce = { key: key, at: now };
        var region = document.getElementById('paper-status');
        if (!region) {
            region = document.createElement('div');
            region.id = 'paper-status';
            region.className = 'sr-only';
            region.setAttribute('role', 'status');
            region.setAttribute('aria-live', 'polite');
            region.setAttribute('aria-atomic', 'true');
            document.body.appendChild(region);
        }
        region.textContent = '';
        region.textContent = message;
    }

    function acknowledge(button, message) {
        if (!button) return;
        var text = message || PHASE_LABEL.submitting;
        button.setAttribute('aria-busy', 'true');
        var host = button.parentElement;
        var status = host ? host.querySelector('[data-paper-inline-status]') : null;
        if (!status) {
            status = document.createElement('span');
            status.className = 'inline-status';
            status.setAttribute('data-paper-inline-status', '');
            button.insertAdjacentElement('afterend', status);
        }
        status.textContent = text;
        announce(text);
    }

    function setFlag(name, on) {
        if (on) root.setAttribute(name, 'reduce');
        else root.removeAttribute(name);
    }

    function syncToggles() {
        var motion = motionReduced();
        var effects = effectsReduced();
        document.querySelectorAll('[data-paper-reduce-motion]').forEach(function (btn) {
            btn.setAttribute('aria-pressed', motion ? 'true' : 'false');
        });
        document.querySelectorAll('[data-paper-reduce-effects]').forEach(function (btn) {
            btn.setAttribute('aria-pressed', effects ? 'true' : 'false');
        });
    }

    function setReduceMotion(on) {
        setFlag('data-paper-motion', on);
        writeStore(MOTION_KEY, on ? '1' : '0');
        syncToggles();
    }
    function setReduceEffects(on) {
        setFlag('data-paper-effects', on);
        writeStore(EFFECTS_KEY, on ? '1' : '0');
        syncToggles();
    }

    if (readStore(MOTION_KEY) === '1') setFlag('data-paper-motion', true);
    if (readStore(EFFECTS_KEY) === '1') setFlag('data-paper-effects', true);

    var params;
    try { params = new URLSearchParams(window.location.search); } catch (err) { params = null; }
    if (params && params.get('motion') === 'reduce') setFlag('data-paper-motion', true);
    if (params && params.get('effects') === 'reduce') setFlag('data-paper-effects', true);

    reduced.addEventListener('change', function () {
        syncToggles();
        if (reduced.matches) announce('Reduced motion is on. Movement is limited to fades.');
    });

    document.addEventListener('click', function (e) {
        var motionBtn = closest(e.target, '[data-paper-reduce-motion]');
        if (motionBtn) {
            if (reduced.matches) {
                announce('System reduced motion stays on.');
                syncToggles();
            } else {
                setReduceMotion(root.getAttribute('data-paper-motion') !== 'reduce');
                announce(motionReduced() ? 'Reduced motion is on. Movement is limited to fades.' : 'Motion follows the system setting.');
            }
        }
        var effectsBtn = closest(e.target, '[data-paper-reduce-effects]');
        if (effectsBtn) {
            setReduceEffects(root.getAttribute('data-paper-effects') !== 'reduce');
            announce(effectsReduced() ? 'Visual effects are reduced.' : 'Visual effects are on.');
        }
        var stateBtn = closest(e.target, '[data-paper-state]');
        if (stateBtn && !stateBtn.disabled) {
            var turningOn = stateBtn.getAttribute('data-state') !== 'on';
            setState(stateBtn, turningOn);
            if (stateBtn.hasAttribute('aria-pressed')) {
                stateBtn.setAttribute('aria-pressed', turningOn ? 'true' : 'false');
            }
            var controlledId = stateBtn.getAttribute('aria-controls');
            var controlled = controlledId && document.getElementById(controlledId);
            if (controlled && stateBtn.getAttribute('data-paper-state') === 'password') {
                if (controlled.type === 'password' || controlled.type === 'text') {
                    controlled.type = turningOn ? 'text' : 'password';
                }
                stateBtn.textContent = turningOn ? 'Hide password' : 'Show password';
            }
        }
        var ack = closest(e.target, '[data-paper-ack]');
        if (ack && !ack.disabled) {
            if (ack.getAttribute('aria-busy') === 'true' && ack.hasAttribute('data-paper-once')) {
                e.preventDefault();
                e.stopPropagation();
                return;
            }
            acknowledge(ack, ack.getAttribute('data-paper-ack') || PHASE_LABEL.submitting);
        }
    });

    /* ---------- nav: scrolled state + mobile sheet ---------- */
    var nav = document.getElementById('nav');
    var toggle = document.getElementById('navToggle');
    var inertTargets = [];

    function onScroll() {
        if (nav) nav.classList.toggle('is-scrolled', window.scrollY > 12);
    }
    window.addEventListener('scroll', onScroll, { passive: true });
    onScroll();

    function focusable(scope) {
        return Array.prototype.filter.call(
            scope.querySelectorAll('a[href], button:not([disabled]), input:not([disabled]), select:not([disabled]), textarea:not([disabled]), [tabindex]:not([tabindex="-1"])'),
            function (el) { return !el.closest('[hidden]') && el.getAttribute('aria-hidden') !== 'true'; }
        );
    }

    function setInert(on) {
        inertTargets.forEach(function (el) {
            if (on) el.setAttribute('inert', '');
            else el.removeAttribute('inert');
        });
    }

    function setOpen(open) {
        if (!nav || !toggle) return;
        nav.classList.toggle('is-open', open);
        toggle.setAttribute('aria-expanded', String(open));
        toggle.setAttribute('aria-label', open ? 'Close menu' : 'Open menu');
        document.body.classList.toggle('nav-locked', open);
        setInert(open);
        if (open) {
            var links = nav.querySelectorAll('.nav__links a, .nav__links button');
            if (links[0]) links[0].focus();
        }
    }

    if (toggle && nav) {
        inertTargets = Array.prototype.filter.call(
            document.querySelectorAll('main, footer'),
            function (el) { return !nav.contains(el); }
        );
        toggle.addEventListener('click', function () {
            setOpen(!nav.classList.contains('is-open'));
        });
        document.addEventListener('keydown', function (e) {
            if (!nav.classList.contains('is-open')) return;
            if (e.key === 'Escape') {
                setOpen(false);
                toggle.focus();
                return;
            }
            if (e.key !== 'Tab') return;
            var items = focusable(nav);
            if (!items.length) return;
            var first = items[0];
            var last = items[items.length - 1];
            if (e.shiftKey && document.activeElement === first) {
                e.preventDefault();
                last.focus();
            } else if (!e.shiftKey && document.activeElement === last) {
                e.preventDefault();
                first.focus();
            }
        });
        nav.querySelectorAll('.nav__links a').forEach(function (a) {
            a.addEventListener('click', function () { setOpen(false); });
        });
        window.matchMedia('(min-width: 901px)').addEventListener('change', function (m) {
            if (m.matches) setOpen(false);
        });
    }

    /* ---------- motion helpers (window.paper) ----------
       Every Paper page uses these. A page with none of them does not
       follow the skill.
         paper.enter(el)     play the entrance now
         paper.reveal(el)    same fade, for a node that just appeared
         paper.section(el)   mark data-section and play the longer fade
         paper.setState(el, 'on' | 'off' | name)
       Markup: data-enter, data-reveal, data-section, data-paper-state.
       data-motion="off" opts a subtree out. Alarms stay visible.
       Reduced motion still runs the fade: --paper-shift is 0. */
    var STAGGER_STEP = 40;
    var STAGGER_CAP = 240;

    function motionOff(el) {
        return !el || el.getAttribute('data-motion') === 'off' || closest(el, '[data-motion="off"]');
    }
    function holdsAlarm(el) {
        return el.matches('.status-critical, .banner, [role="alert"], .error') ||
            !!el.querySelector('.status-critical, [role="alert"]');
    }
    function motionNodes(selector) {
        return Array.prototype.filter.call(document.querySelectorAll(selector), function (el) {
            return !motionOff(el) && !holdsAlarm(el);
        });
    }
    function unique(list) {
        var seen = [];
        list.forEach(function (el) { if (seen.indexOf(el) < 0) seen.push(el); });
        return seen;
    }
    function capDelay(el, index) {
        var authored = el.style.getPropertyValue('--d');
        if (authored) {
            var ms = parseFloat(authored) * (/ms/i.test(authored) ? 1 : 1000);
            if (ms > STAGGER_CAP) el.style.setProperty('--d', STAGGER_CAP + 'ms');
            return;
        }
        var delay = index < 6 ? Math.min(STAGGER_CAP, index * STAGGER_STEP) : 0;
        el.style.setProperty('--d', delay + 'ms');
    }
    function playIn(el) {
        if (motionOff(el) || holdsAlarm(el)) return el;
        el.classList.add('is-motion');
        el.classList.remove('is-in');
        void el.offsetWidth;
        el.classList.add('is-in');
        return el;
    }
    function enter(el) { return playIn(el); }
    function reveal(el) { return playIn(el); }
    function section(el) {
        if (el && !motionOff(el)) el.setAttribute('data-section', '');
        return playIn(el);
    }
    function setState(el, state) {
        if (!el) return el;
        var name = state === true ? 'on' : state === false ? 'off' : String(state);
        el.setAttribute('data-state', name);
        el.classList.toggle('is-on', name === 'on');
        return el;
    }

    var enters = unique(motionNodes('[data-enter], .page-hero .eyebrow, .page-hero .display, .page-hero .lead, .page-hero .btns, .hero__title, .hero__foot, .login-card'));
    var staged = unique(motionNodes('[data-reveal], [data-section], .card, section.section, .pane'));
    enters.forEach(function (el, i) { capDelay(el, i); playIn(el); });
    staged.forEach(function (el, i) {
        if (enters.indexOf(el) !== -1) return;
        capDelay(el, i);
        el.classList.add('is-motion');
    });
    if ('IntersectionObserver' in window) {
        var io = new IntersectionObserver(function (entriesObserved) {
            entriesObserved.forEach(function (entry) {
                if (!entry.isIntersecting) return;
                entry.target.classList.add('is-in');
                io.unobserve(entry.target);
            });
        }, { rootMargin: '0px 0px -8% 0px', threshold: 0.08 });
        staged.forEach(function (el) {
            if (enters.indexOf(el) !== -1) return;
            io.observe(el);
        });
    } else {
        staged.forEach(function (el) { el.classList.add('is-in'); });
    }
    setTimeout(function () {
        document.querySelectorAll('.is-motion:not(.is-in)').forEach(function (el) {
            var rect = el.getBoundingClientRect();
            if (rect.top < window.innerHeight && rect.bottom > 0) el.classList.add('is-in');
        });
    }, 800);

    /* ---------- meters read their width from data-pct ---------- */
    document.querySelectorAll('.meter__fill[data-pct]').forEach(function (el) {
        el.style.setProperty('--pct', el.dataset.pct + '%');
    });

    /* Counters are not tweened. Intermediate digits would invent readings.
       The authored text is the value. */

    /* ---------- footer year ---------- */
    var year = document.getElementById('year');
    if (year) year.textContent = String(new Date().getFullYear());

    /* Title is already visible. is-loaded remains for older page CSS. */
    document.body.classList.add('is-loaded');

    /* ---------- native dialogs ---------- */
    function openDialog(dlg, opener) {
        if (!dlg || typeof dlg.showModal !== 'function') return;
        dlg.__paperOpener = opener || null;
        if (!dlg.open) dlg.showModal();
        var initial = dlg.querySelector('[data-paper-initial-focus], h1, h2');
        if (initial) {
            if (!initial.hasAttribute('tabindex')) initial.setAttribute('tabindex', '-1');
            initial.focus();
        }
    }
    document.querySelectorAll('dialog').forEach(function (dlg) {
        dlg.addEventListener('close', function () {
            var opener = dlg.__paperOpener;
            if (opener && opener.isConnected) opener.focus();
        });
    });
    document.addEventListener('click', function (e) {
        var closer = closest(e.target, '[data-paper-dialog-close]');
        if (closer) {
            var parent = closer.closest('dialog');
            if (parent && parent.open && typeof parent.close === 'function') parent.close();
        }
        var opener = closest(e.target, '[data-paper-dialog]');
        if (!opener) return;
        var dlg = document.getElementById(opener.getAttribute('data-paper-dialog'));
        if (!dlg) return;
        e.preventDefault();
        openDialog(dlg, opener);
    });

    /* ---------- local forms: errors stay associated with fields ---------- */
    document.querySelectorAll('form[data-paper-form]').forEach(function (form) {
        form.noValidate = true;
    });
    document.addEventListener('submit', function (e) {
        var form = e.target;
        if (!form || !form.hasAttribute || !form.hasAttribute('data-paper-form')) return;
        var fields = form.querySelectorAll('input, select, textarea');
        Array.prototype.forEach.call(fields, function (field) {
            if (!field.hasAttribute('data-paper-number')) return;
            var raw = field.value.trim();
            if (!raw) {
                field.setCustomValidity('');
                return;
            }
            var numeric = raw.split(/\s+/)[0];
            field.setCustomValidity(parseStrictNumber(numeric) === null
                ? 'Enter a decimal number, without grouping separators.'
                : '');
        });
        if (!form.checkValidity()) {
            e.preventDefault();
            Array.prototype.forEach.call(fields, function (field) {
                var bad = !field.checkValidity();
                if (bad) field.setAttribute('aria-invalid', 'true');
                else field.removeAttribute('aria-invalid');
                (field.getAttribute('aria-describedby') || '').split(/\s+/).forEach(function (id) {
                    var node = id && document.getElementById(id);
                    if (node && node.classList.contains('error')) {
                        node.hidden = !bad;
                        if (bad && field.validationMessage) node.textContent = field.validationMessage;
                    }
                });
            });
            var summary = form.querySelector('.error-summary');
            if (summary) {
                summary.hidden = false;
                if (!summary.hasAttribute('tabindex')) summary.setAttribute('tabindex', '-1');
                summary.focus();
            }
            announce('Check the highlighted fields.');
            return;
        }
        if (form.hasAttribute('data-paper-local')) {
            e.preventDefault();
            var note = form.querySelector('[data-paper-draft-note]');
            if (note) {
                note.hidden = false;
                var stamp = note.querySelector('time');
                if (stamp) {
                    var iso = new Date().toISOString();
                    stamp.setAttribute('datetime', iso);
                    stamp.textContent = iso;
                }
            }
            announce('Draft saved on this page. Nothing was sent.');
            writeDraft(form);
        }
    }, true);

    /* ---------- sortable tables. Missing numbers sort last, not as zero. ---------- */
    document.querySelectorAll('table[data-paper-sort]').forEach(function (table) {
        table.querySelectorAll('thead button[data-sort]').forEach(function (btn) {
            btn.addEventListener('click', function () {
                var th = btn.closest('th');
                if (!th || !th.parentNode) return;
                var index = Array.prototype.indexOf.call(th.parentNode.children, th);
                var type = btn.getAttribute('data-sort-type') || 'text';
                var dir = btn.getAttribute('aria-sort') === 'ascending' ? 'descending' : 'ascending';
                table.querySelectorAll('thead button[data-sort]').forEach(function (other) {
                    other.removeAttribute('aria-sort');
                });
                btn.setAttribute('aria-sort', dir);
                var tbody = table.querySelector('tbody');
                if (!tbody) return;
                var rows = Array.prototype.slice.call(tbody.querySelectorAll('tr'));
                rows.sort(function (a, b) {
                    var ac = a.children[index];
                    var bc = b.children[index];
                    var av = ac ? (ac.getAttribute('data-value') != null ? ac.getAttribute('data-value') : ac.textContent) : '';
                    var bv = bc ? (bc.getAttribute('data-value') != null ? bc.getAttribute('data-value') : bc.textContent) : '';
                    return compareCell(av, bv, type, dir);
                });
                rows.forEach(function (row) { tbody.appendChild(row); });
            });
        });
    });

    /* ---------- tabs: arrow keys when a real tablist is marked ---------- */
    document.querySelectorAll('[role="tablist"]').forEach(function (list) {
        var tabs = Array.prototype.slice.call(list.querySelectorAll('[role="tab"]'));
        tabs.forEach(function (tab) {
            var panel = document.getElementById(tab.getAttribute('aria-controls'));
            if (panel) panel.hidden = tab.getAttribute('aria-selected') !== 'true';
        });
        function activate(tab) {
            tabs.forEach(function (item) {
                var on = item === tab;
                item.setAttribute('aria-selected', on ? 'true' : 'false');
                item.tabIndex = on ? 0 : -1;
                var panel = document.getElementById(item.getAttribute('aria-controls'));
                if (panel) panel.hidden = !on;
            });
            tab.focus();
        }
        list.addEventListener('keydown', function (e) {
            var current = tabs.indexOf(document.activeElement);
            if (current < 0) return;
            var next = null;
            if (e.key === 'ArrowRight' || e.key === 'ArrowDown') next = tabs[(current + 1) % tabs.length];
            else if (e.key === 'ArrowLeft' || e.key === 'ArrowUp') next = tabs[(current - 1 + tabs.length) % tabs.length];
            else if (e.key === 'Home') next = tabs[0];
            else if (e.key === 'End') next = tabs[tabs.length - 1];
            if (!next) return;
            e.preventDefault();
            activate(next);
        });
        tabs.forEach(function (tab) {
            tab.addEventListener('click', function () { activate(tab); });
        });
    });

    syncToggles();

    /* Named ledger views, a local export, and a tab-scoped draft. */
    var PRESET_NOTE = {
        all: 'All assets in this ledger.',
        attention: 'Assets that need attention: critical, offline, or missing data.',
        running: 'Assets whose state says Running.'
    };
    function applyPreset(group, name) {
        var table = document.getElementById(group.getAttribute('data-paper-presets'));
        if (!table || !table.tBodies[0]) return;
        Array.prototype.forEach.call(table.tBodies[0].rows, function (row) {
            var state = row.cells[1] ? row.cells[1].textContent : '';
            var show = name === 'all'
                || (name === 'attention' && /Critical|Offline|Unavailable|Disconnected/i.test(state))
                || (name === 'running' && /Running/i.test(state));
            row.hidden = !show;
        });
        group.querySelectorAll('[data-paper-preset]').forEach(function (btn) {
            btn.setAttribute('aria-pressed', btn.getAttribute('data-paper-preset') === name ? 'true' : 'false');
        });
        var noteId = group.getAttribute('aria-describedby');
        var note = noteId && document.getElementById(noteId);
        if (note && PRESET_NOTE[name]) note.textContent = PRESET_NOTE[name];
    }
    document.querySelectorAll('[data-paper-presets]').forEach(function (group) {
        group.addEventListener('click', function (e) {
            var btn = closest(e.target, '[data-paper-preset]');
            if (!btn) return;
            applyPreset(group, btn.getAttribute('data-paper-preset') || 'all');
        });
    });
    document.querySelectorAll('table[data-paper-sort]').forEach(function (table) {
        if (table.tBodies[0]) table.tBodies[0].__paperOrder = Array.prototype.slice.call(table.tBodies[0].rows);
    });
    function draftKey(form) {
        return 'paper-draft:' + location.pathname + '#' + (form.id || 'form');
    }
    function writeDraft(form) {
        if (!form || !form.hasAttribute('data-paper-persist')) return;
        var data = {};
        Array.prototype.forEach.call(form.elements, function (field) {
            if (!field.name || field.type === 'password' || field.type === 'file') return;
            data[field.name] = field.value;
        });
        try { sessionStorage.setItem(draftKey(form), JSON.stringify(data)); } catch (err) { /* storage blocked */ }
    }
    function clearDraft(form) {
        try { sessionStorage.removeItem(draftKey(form)); } catch (err) { /* storage blocked */ }
        Array.prototype.forEach.call(form.elements, function (field) {
            if (!field.name || field.type === 'password' || field.type === 'file') return;
            field.value = '';
            field.removeAttribute('aria-invalid');
        });
        var note = form.querySelector('[data-paper-draft-note]');
        if (note) note.hidden = true;
        announce('Draft discarded on this page. Nothing was sent.');
    }
    document.querySelectorAll('form[data-paper-persist]').forEach(function (form) {
        var raw = null;
        try { raw = sessionStorage.getItem(draftKey(form)); } catch (err) { raw = null; }
        if (!raw) return;
        var data;
        try { data = JSON.parse(raw); } catch (err) { return; }
        var restored = false;
        Object.keys(data).forEach(function (name) {
            var field = form.elements[name];
            if (!field || field.type === 'password') return;
            field.value = data[name];
            restored = true;
        });
        if (!restored) return;
        var note = form.querySelector('[data-paper-draft-note]');
        if (note) note.hidden = false;
        announce('Draft restored on this page. Nothing was sent.');
    });
    document.addEventListener('click', function (e) {
        var exp = closest(e.target, '[data-paper-export]');
        if (exp) {
            var table = document.getElementById(exp.getAttribute('data-paper-export'));
            if (!table || !table.tBodies[0]) return;
            var lines = [];
            Array.prototype.forEach.call(table.tBodies[0].rows, function (row) {
                if (row.hidden) return;
                lines.push(Array.prototype.map.call(row.cells, function (cell) {
                    return cell.textContent.replace(/\s+/g, ' ').trim();
                }).join('\t'));
            });
            var blob = new Blob([lines.join('\n') + '\n'], { type: 'text/plain' });
            var url = URL.createObjectURL(blob);
            var link = document.createElement('a');
            link.href = url;
            link.download = 'ledger.txt';
            document.body.appendChild(link);
            link.click();
            link.remove();
            URL.revokeObjectURL(url);
            announce('Exported the visible rows. Nothing was sent.');
        }
        var restore = closest(e.target, '[data-paper-restore]');
        if (restore) {
            var restoredTable = document.getElementById(restore.getAttribute('data-paper-restore'));
            if (restoredTable && restoredTable.tBodies[0] && restoredTable.tBodies[0].__paperOrder) {
                restoredTable.tBodies[0].__paperOrder.forEach(function (row) {
                    restoredTable.tBodies[0].appendChild(row);
                });
                restoredTable.querySelectorAll('[aria-sort]').forEach(function (node) {
                    node.removeAttribute('aria-sort');
                });
            }
            document.querySelectorAll('[data-paper-presets]').forEach(function (group) {
                if (!restoredTable || group.getAttribute('data-paper-presets') === restoredTable.id) applyPreset(group, 'all');
            });
            announce('Restored the authored order.');
        }
        var discard = closest(e.target, '[data-paper-discard]');
        if (discard) {
            var form = closest(discard, 'form');
            if (form) clearDraft(form);
        }
    });

    window.paper = {
        motionReduced: motionReduced,
        effectsReduced: effectsReduced,
        setReduceMotion: setReduceMotion,
        setReduceEffects: setReduceEffects,
        announce: announce,
        phaseLabel: phaseLabel,
        acknowledge: acknowledge,
        openDialog: openDialog,
        parseStrictNumber: parseStrictNumber,
        compareCell: compareCell,
        enter: enter,
        reveal: reveal,
        section: section,
        setState: setState
    };
})();
)ROS_PAPERJS";
static const unsigned PAGE_JS_LEN = 29071;

static const char PAGE_SETUP_JS[] = R"ROS_SETUPJS(// Setup page for a routeOS board. Everything it shows comes from the board's own API; this file only asks and renders.
const $ = (id) => document.getElementById(id);
const status = (text) => {
    const line = $('paper-status');
    if (!line) return;
    line.textContent = '';
    requestAnimationFrame(() => { line.textContent = text; });
};

const store = {
    get token() { return localStorage.getItem('routeos-token') || ''; },
    set token(value) { localStorage.setItem('routeos-token', value); },
};

async function call(method, path, body, needsToken = true) {
    const headers = {};
    if (needsToken) headers.Authorization = `Bearer ${store.token}`;
    if (body !== undefined) headers['Content-Type'] = 'application/json';
    const response = await fetch(path, { method, headers, body: body === undefined ? undefined : JSON.stringify(body) });
    const text = await response.text();
    let json = null;
    try { json = text ? JSON.parse(text) : null; } catch { /* not JSON: keep the text */ }
    if (!response.ok) {
        const message = (json && json.error) || text || `HTTP ${response.status}`;
        const error = new Error(message);
        error.status = response.status;
        throw error;
    }
    return json ?? text;
}

function badge(ok, text) {
    return `<span class="badge badge--${ok ? 'ok' : 'warn'}">${text}</span>`;
}

function rssiText(rssi) {
    if (!rssi) return '—';
    const bars = rssi > -55 ? 'excellent' : rssi > -65 ? 'good' : rssi > -75 ? 'fair' : 'weak';
    return `${rssi} dBm · ${bars}`;
}

async function loadWifi() {
    const wifi = await call('GET', '/api/wifi');
    $('stLink').innerHTML = wifi.connected ? badge(true, 'connected') : badge(false, 'not connected');
    $('stSsid').textContent = wifi.ssid || wifi.saved_ssid || wifi.builtin_ssid || 'none';
    $('stIp').textContent = wifi.ip || '—';
    $('stRssi').textContent = rssiText(wifi.rssi);
    $('stChannel').textContent = wifi.channel || '—';
    $('stMac').textContent = wifi.mac || '—';
    $('stSource').textContent = wifi.source || '—';
    return wifi;
}

async function loadBoard() {
    const caps = await call('GET', '/api/capabilities', undefined, false);
    const device = caps.device || {};
    const memory = caps.memory || {};
    $('boardTitle').textContent = device.chip || 'board';
    $('bdChip').textContent = `${device.chip || '—'} rev ${device.revision ?? '—'} · ${device.cores || '—'} cores at ${device.cpu_mhz || '—'} MHz`;
    $('bdFw').textContent = `${(caps.firmware && caps.firmware.name) || '—'} ${(caps.firmware && caps.firmware.version) || ''}`.trim();
    $('bdFlash').textContent = device.flash_mb ? `${device.flash_mb} MB` : '—';
    $('bdPsram').textContent = device.psram_kb ? `${Math.round(device.psram_kb / 1024)} MB` : 'none';
    $('bdHeap').textContent = memory.heap_free_kb ? `${memory.heap_free_kb} KB free of ${memory.heap_total_kb} KB` : '—';
    $('bdUptime').textContent = (caps.uptime_s !== undefined) ? `${Math.round(caps.uptime_s)} s` : '—';
    return caps;
}

function showLocked() {
    $('stLink').innerHTML = badge(false, 'locked');
    $('stSsid').textContent = 'enter the token to read this';
    for (const id of ['stIp', 'stRssi', 'stChannel', 'stMac', 'stSource']) $(id).textContent = '—';
}

let unlocked = false;

async function unlock(quiet = false) {
    if (!store.token) {
        if (!quiet) $('unlockState').textContent = 'no token';
        return false;
    }
    try {
        await call('GET', '/api/system');
        unlocked = true;
        $('unlockState').textContent = 'unlocked';
        status('Token accepted. Showing the board.');
        loadWifi().catch(() => {});
        return true;
    } catch (error) {
        unlocked = false;
        showLocked();
        $('unlockState').textContent = error.status === 401 ? 'token rejected' : error.message;
        if (!quiet) status('The board did not accept that token.');
        return false;
    }
}

async function scan() {
    $('scanState').textContent = 'scanning…';
    $('networks').innerHTML = '';
    try {
        await call('POST', '/api/wifi/scan');
        for (let i = 0; i < 40; i++) {
            const result = await call('GET', '/api/wifi/scan');
            if (!result.running) {
                renderNetworks(result.networks || []);
                $('scanState').textContent = `${(result.networks || []).length} found`;
                return;
            }
            await new Promise((resolve) => setTimeout(resolve, 700));
        }
        $('scanState').textContent = 'scan timed out';
    } catch (error) {
        $('scanState').textContent = error.message;
    }
}

function renderNetworks(networks) {
    const list = $('networks');
    list.innerHTML = '';
    if (!networks.length) {
        list.innerHTML = '<li class="hint">No networks reported. Move the board closer to the router.</li>';
        return;
    }
    for (const network of networks) {
        const item = document.createElement('li');
        const button = document.createElement('button');
        button.type = 'button';
        button.className = 'btn btn--sm';
        button.style.width = '100%';
        button.style.justifyContent = 'space-between';
        button.innerHTML = `<span>${network.ssid || '(hidden)'}</span>
            <span class="mono">${network.rssi} dBm${network.connected ? ' · connected' : ''}</span>`;
        button.addEventListener('click', () => {
            $('ssid').value = network.ssid || '';
            $('password').focus();
            status(`Selected ${network.ssid}.`);
        });
        if (!network.supported) {
            button.disabled = true;
            button.title = 'This board cannot join that network type.';
        }
        item.appendChild(button);
        list.appendChild(item);
    }
}

async function join() {
    const ssid = $('ssid').value.trim();
    if (!ssid) { status('Type or pick a network name first.'); return; }
    $('joinHint').textContent = 'Sending the new network…';
    try {
        await call('PUT', '/api/wifi', { ssid, password: $('password').value });
        $('joinHint').textContent = 'Trying it now. The board falls back to the old network if this one fails.';
        status(`Trying ${ssid}.`);
        for (let i = 0; i < 25; i++) {
            await new Promise((resolve) => setTimeout(resolve, 1000));
            try {
                const wifi = await loadWifi();
                if (wifi.connected && wifi.ssid === ssid) {
                    $('joinHint').textContent = `Joined ${ssid} — the board is at ${wifi.ip}.`;
                    status('Joined the new network.');
                    return;
                }
            } catch { /* the radio is restarting, the page will come back */ }
        }
        $('joinHint').textContent = 'No confirmation yet. Reload the page to see what happened.';
    } catch (error) {
        $('joinHint').textContent = error.message;
        status('The board refused the change.');
    }
}

async function test() {
    $('testState').textContent = 'running…';
    $('testResult').hidden = true;
    try {
        const result = await call('POST', '/api/test');
        $('testState').textContent = `${result.ms} ms`;
        $('testResult').hidden = false;
        $('testResult').className = 'banner ' + (result.ok ? 'banner--ok' : 'banner--err');
        $('testText').innerHTML = result.ok
            ? `Reached <span class="mono">https://yeems214.xyz</span> — HTTP ${result.status} in ${result.ms} ms, TLS ${result.tls}.`
            : `Could not reach <span class="mono">https://yeems214.xyz</span> after ${result.ms} ms: ${result.error}.`;
        status(result.ok ? 'The link test passed.' : 'The link test failed.');
    } catch (error) {
        $('testState').textContent = 'failed';
        $('testResult').hidden = false;
        $('testResult').className = 'banner banner--err';
        $('testText').textContent = error.message;
    }
}

$('unlockBtn').addEventListener('click', async () => {
    store.token = $('token').value.trim();
    await unlock();
});
$('token').addEventListener('keydown', (event) => {
    if (event.key === 'Enter') $('unlockBtn').click();
});
$('refreshBtn').addEventListener('click', () => loadWifi().catch((error) => status(error.message)));
$('scanBtn').addEventListener('click', scan);
$('joinBtn').addEventListener('click', join);
$('testBtn').addEventListener('click', test);
$('rebootBtn').addEventListener('click', async () => {
    try {
        await call('POST', '/api/reboot');
        status('The board is restarting.');
        $('rebootBtn').disabled = true;
    } catch (error) {
        status(error.message);
    }
});

// Fill everything that needs no token first, so the page is useful before the token is typed in.
$('year').textContent = new Date().getFullYear();
loadBoard().catch(() => {});
$('token').value = store.token;
unlock(true).then((ok) => { if (!ok) showLocked(); });
)ROS_SETUPJS";
static const unsigned PAGE_SETUP_JS_LEN = 9002;
